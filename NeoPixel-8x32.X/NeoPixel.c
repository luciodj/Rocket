/*
 *   Basic OLED SSD1306 display driver
 */
#include "NeoPixel.h"
#include <string.h>

uint8_t _x;                 // cursor column
uint32_t _bgColor = 0;       // background color
uint8_t buffer[ 3 * N_LED + 6*24]; //    G, R, B,  buffer + extension char
uint8_t *_end = &buffer + sizeof(buffer);

void NeoPixel_Send(uint8_t *p, uint8_t count) 
{   // sends count x RGB data packets (24-bit each)
    uint8_t bitCount, data;
    do {
        bitCount = 24;
        do {
            if ((bitCount & 7) == 0) {
                data = *p++ & POWER_LIMIT;    // optionally << to control brightness
            }
            SSPBUF = ((data & 0x80)) ? 0xF0 : 0x80;  // WS2812B 900ns - 350ns
            data <<= 1;
        } while (--bitCount);
        if (p >= _end) p = &buffer;
    } while ( --count);
}

void NeoPixel_Show(void)
{
    NeoPixel_Send(buffer, N_LED);
}

void NeoPixel_SetColumn(uint8_t x)
{
    _x = x;
}

void NeoPixel_Clear(uint32_t color)
{
    uint8_t i,j, *bp = buffer;
    for(i=0; i<NEO_COLUMNS+6; i++)  // include the extension char
        for(j=0; j<NEO_ROWS; j++) {
            *bp++ = color >> 8;  // G
            *bp++ = color >> 16; // R
            *bp++ = color;       // B
        }
    _bgColor = color;
}

void NeoPixel_Gradient(uint32_t color, uint32_t grad)
{
    uint8_t i,j, *bp = buffer;
    uint8_t r, gr, g, gg, b, gb ;
    g = color >> 8;   r = color >> 16; b = color;
    gg = (grad >> 8);gr = grad >> 16; gb = grad;
    for(i=0; i<NEO_COLUMNS; i++) {
        for(j=0; j<NEO_ROWS; j++) {
            *bp++ = g;  // G
            *bp++ = r;  // R
            *bp++ = b;  // B
        }    
        g += gg; r += gr; b += gb;
    }
}

const uint8_t inv[8] = {15*3, 13*3, 11*3, 9*3, 7*3, 5*3, 3*3, 3};

void NeoPixel_ShiftLeft(void)
{
    uint8_t i, j, *bp = buffer;
    for(i=0; i<NEO_COLUMNS+5; i+=1) {
    // invert as you shift (zig zag pattern)
        for(j=0; j<8; j++) {
            memcpy(bp, &bp[inv[j]], 3);  // copy color information
            bp += 3;
        }
    }
}

const uint8_t font[] = { // 8 rows x 5 cols 
    0x00,0x00,0x00,0x00,0x00,0x00,0x00,0x5F,0x00,0x00,0x00,0x07,0x00,0x07,0x00, //	'sp,!,"
    0x14,0x7F,0x14,0x7F,0x14, // #
    0x24,0x2A,0x7F,0x2A,0x12,0x23,0x13,0x08,0x64,0x62,0x36,0x49,0x56,0x20,0x50, //	'$,%,&
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    0x02,0x01,0x02,0x04,0x02                                                    //  '~
    };

void NeoPixel_Putchar( char ch, uint32_t color)
{ // color is 0RGB
    uint8_t i, j, col;
    const uint8_t *f = &font[(ch-' ')*5];   // source pointer
    uint8_t *bp = &buffer[_x*24];           // dest pointer 
    uint8_t mask = 1;
    for( i=0; i<5; i++) {   // loop by columns        
        if (bp > _end) break;
        col = *f++;         // grab one column
        mask =  (_x & 1) ? 0x80 : 1;    // odd columns are MSB first
        for(j=0; j<8; j++) {     // loop by rows/pixels
            if (col & mask) {
                *bp++ = color >> 8;  // G
                *bp++ = color >> 16; // R
                *bp++ = color;       // B
            } else {
                *bp++ = _bgColor >> 8;  // G
                *bp++ = _bgColor >> 16; // R
                *bp++ = _bgColor;       // B
            }
            if (_x & 1) col <<= 1;  // odd lines shift left
            else col >>= 1;         // even lines shift right
        }        
        _x++;           // next column
    }
    _x++;
}

void NeoPixel_Puts( uint8_t x, char *s, uint32_t color)
{
    NeoPixel_SetColumn(x);    
    while( *s) {
        NeoPixel_Putchar( *s++, color);
    }
}

void NeoPixel_Scroll( char *s, uint32_t color, bool start)
{
    static uint8_t count=0, index=0;
    if (start) {
        NeoPixel_Clear( _bgColor);
        count = 0;
    } 
    if (s[count] == '\0') count=0;    // roll over
    if (index++ == 0) {
        NeoPixel_SetColumn(NEO_COLUMNS);    // point to the extension buffer
        if (color == 0) {
            color = rand();
            color = ((color & 0xf800) << 8) + ((color & 0x7c0) << 2) + (color & 0x3f);
        }
        NeoPixel_Putchar(s[count++], color);    
    }
    NeoPixel_ShiftLeft();
    NeoPixel_Show();
    index %= 6; 
}

